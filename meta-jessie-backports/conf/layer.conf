## meta-jessie-backports/conf/layer.conf
```bitbake
# We have a conf and classes directory, add to BBPATH
#BBPATH =. "${LAYERDIR}:"
BBPATH .= ":${LAYERDIR}"

# We have recipes-* directories, add to BBFILES
BBFILES += "${LAYERDIR}/recipes-*/*/*.bb \
            ${LAYERDIR}/recipes-*/*/*.bbappend"

BBFILE_COLLECTIONS += "jessie-backports"
BBFILE_PATTERN_jessie-backports = "^${LAYERDIR}/"
BBFILE_PRIORITY_jessie-backports ?= "9"

# This should only be incremented on significant changes that will
# cause compatibility issues with other layers
LAYERVERSION_jessie-backports = "1"
LAYERDEPENDS_jessie-backports = "debian"

LICENSE_PATH += "${LAYERDIR}/files/common-licenses"
```

## meta-stretch/conf/layer.conf
```bitbake
# We have a conf and classes directory, add to BBPATH
#BBPATH =. "${LAYERDIR}:"
BBPATH .= ":${LAYERDIR}"

# We have recipes-* directories, add to BBFILES
BBFILES += "${LAYERDIR}/recipes-*/*/*.bb \
            ${LAYERDIR}/recipes-*/*/*.bbappend"

BBFILE_COLLECTIONS += "stretch"
BBFILE_PATTERN_stretch = "^${LAYERDIR}/"
BBFILE_PRIORITY_stretch ?= "9"

# This should only be incremented on significant changes that will
# cause compatibility issues with other layers
LAYERVERSION_stretch = "1"
LAYERDEPENDS_stretch = "debian"

LICENSE_PATH += "${LAYERDIR}/licenses"

# Require for building ruby
SANITY_REQUIRED_UTILITIES += "ruby"
```
